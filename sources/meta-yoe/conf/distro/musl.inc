## sources/meta-yoe/conf/distro/report-error.inc
```bitbake
INHERIT += "report-error"
ERR_REPORT_SERVER = "errors.yoctoproject.org"
ERR_REPORT_PORT = "80"
ERR_REPORT_USERNAME = "Khem Raj"
ERR_REPORT_EMAIL = "khem@yoedistro.org"
```

## sources/meta-yoe/conf/distro/scanbuild.inc
```bitbake
#INHERIT += "scan-build"
SCAN_BUILD ?= ""
# Just run static analysis on openssl
#SCAN_BUILD:pn-openssl = "1"
```

## sources/meta-yoe/conf/distro/systemd.inc
```bitbake
# Use systemd for system initialization
INIT_MANAGER = "systemd"
# Use dbus broker instead of traditional dbus daemon
# It's more modern and robust although might take a bit extra memory ( 8MB )
VIRTUAL-RUNTIME_dbus = "dbus-broker"
```

## sources/meta-yoe/conf/distro/wayland.inc
```bitbake
DISTRO_FEATURES:append = " wayland"
DISTRO_FEATURES_DEFAULT:remove = "x11"
PACKAGECONFIG:append:pn-cog:rpi = " drm"
```

## sources/meta-yoe/conf/distro/yoe-glibc-busyboxinit-eglfs.inc
```bitbake
require yoe.inc
require glibc.inc
require busyboxinit.inc
require eglfs.inc
require mdev.inc
```

## sources/meta-yoe/conf/distro/yoe-musl-busyboxinit-eglfs.inc
```bitbake
require yoe.inc
require musl.inc
require busyboxinit.inc
require eglfs.inc
require mdev.inc
```

## sources/meta-yoe/conf/distro/yoe.conf
```bitbake
require yoe.inc
require glibc.inc
require systemd.inc
require wayland.inc
require qt6.inc
```
