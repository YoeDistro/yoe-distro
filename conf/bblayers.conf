## conf/bblayers.conf
```bitbake
# LAYER_CONF_VERSION is increased each time build/conf/bblayers.conf
# changes incompatibly
LCONF_VERSION = "7"
#TOPDIR := "${@os.path.dirname(os.path.dirname(d.getVar('FILE', True)))}"

require ${TOPDIR}/sources/meta-yoe/conf/projects/${PROJECT}/layers.conf

# Placeholder for devtool adding layers as it does not understand above
# location for finding BBLAYERS
BBLAYERS += " \
  "
```

## conf/distro/bec.conf
```bitbake
#
# Distro Settings
#
DISTRO = "bec"
DISTRO_NAME = "BEC Linux"
MAINTAINER = "BEC Systems <support@bec-systems.com>"
TARGET_VENDOR = "-bec"
SDK_VENDOR = "-becsdk"

PREMIRRORS ??= "\
bzr://.*/.*   http://downloads.yoctoproject.org/mirror/sources/ \n \
cvs://.*/.*   http://downloads.yoctoproject.org/mirror/sources/ \n \
git://.*/.*   http://downloads.yoctoproject.org/mirror/sources/ \n \
gitsm://.*/.* http://downloads.yoctoproject.org/mirror/sources/ \n \
hg://.*/.*    http://downloads.yoctoproject.org/mirror/sources/ \n \
osc://.*/.*   http://downloads.yoctoproject.org/mirror/sources/ \n \
p4://.*/.*    http://downloads.yoctoproject.org/mirror/sources/ \n \
svn://.*/.*   http://downloads.yoctoproject.org/mirror/sources/ \n"

MIRRORS =+ "\
ftp://.*/.*      http://downloads.yoctoproject.org/mirror/sources/ \n \
http://.*/.*     http://downloads.yoctoproject.org/mirror/sources/ \n \
https://.*/.*    http://downloads.yoctoproject.org/mirror/sources/ \n"

MIRRORS_append = "\
    git://.*/.* http://sources.bec-systems.com/ \n \
    ftp://.*/.* http://sources.bec-systems.com/ \n \
    http://.*/.* http://sources.bec-systems.com/ \n \
    https://.*/.* http://sources.bec-systems.com/ \n"

PRSERV_HOST = "localhost:0"
TCLIBCAPPEND = ""

BUILDHISTORY_COMMIT = "1"

# the following is required because some BSP layers (fsl) don't set this, and then
# other BSP layers fail bitbake parsing (ti).
MACHINE_KERNEL_PR ??= "0"

# accound for some layers which have bbappends for layers we dont include
BB_DANGLINGAPPENDS_WARNONLY = "1"

# Poky goodness
# QA check settings - a little stricter than the OE-Core defaults
WARN_TO_ERROR_QA = "already-stripped compile-host-path install-host-path \
                    installed-vs-shipped ldflags pn-overrides rpaths staticdev \
                    useless-rpaths"
WARN_QA_remove = "${WARN_TO_ERROR_QA}"
ERROR_QA_append = " ${WARN_TO_ERROR_QA}"
#ERROR_QA_remove  = "split-strip"
#
# Additional image features
#
# The following is a list of additional classes to use when building images which
# enable extra features. Some available options which can be included in this variable
# are:
#   - 'buildstats' collect build statistics
#   - 'image-mklibs' to reduce shared library files size for an image
#   - 'image-prelink' in order to prelink the filesystem image
#   - 'image-swab' to perform host system intrusion detection
# NOTE: if listing mklibs & prelink both, then make sure mklibs is before prelink
# NOTE: mklibs also needs to be explicitly enabled for a given image, see local.conf.extended
# image-prelink sometimes disabled due to issues with IFUNC symbol relocation
USER_CLASSES ?= "buildstats buildhistory buildstats-summary image-mklibs image-prelink"

require conf/distro/include/no-static-libs.inc
#require conf/distro/include/yocto-uninative.inc
require conf/distro/include/security_flags.inc

#INHERIT += "uninative"

DISTRO_FEATURES_append = " largefile opengl ptest multiarch wayland pam "

# Enable thumb2 by default
ARM_INSTRUCTION_SET = "thumb"
```

## conf/distro/busyboxinit.inc
```bitbake
VIRTUAL-RUNTIME_init_manager = "busybox"
VIRTUAL-RUNTIME_dev_manager = "busybox-mdev"
VIRTUAL-RUNTIME_login_manager = "busybox"
```

## conf/distro/systemd.inc
```bitbake
DISTRO_FEATURES_append = " systemd"
VIRTUAL-RUNTIME_init_manager = "systemd"
DISTRO_FEATURES_BACKFILL_CONSIDERED = "sysvinit"
VIRTUAL-RUNTIME_initscripts = ""
```

## conf/distro/yoe.inc
```bitbake
#
# Distro Settings
#
DISTRO_NAME = "Yoe Linux"
MAINTAINER = "Yoe Distro Community <http://yoedistro.org>"
TARGET_VENDOR = "-yoe"
SDK_VENDOR = "-yoesdk"
# Distro version keep it up with Yocto release
DISTRO_VERSION = "3.1"
DISTRO_CODENAME = "argali"
SDK_VERSION := "${DISTRO_VERSION}"

SDK_NAME_PREFIX = "yoe"
SDK_NAME = "${SDK_NAME_PREFIX}-${SDKMACHINE}-${IMAGE_BASENAME}-${TUNE_PKGARCH}-${MACHINE}"
SDKPATH = "/opt/${SDK_NAME_PREFIX}/${SDK_VERSION}"
SDKEXTPATH = "~/${SDK_NAME_PREFIX}_sdk/${DISTRO_VERSION}"
SDK_INCLUDE_NATIVESDK = "1"

DISTRO_VERSION[vardepsexclude] = "DATE"
SDK_VERSION[vardepsexclude] = "DATE"

PREMIRRORS ??= "\
bzr://.*/.*   http://downloads.yoctoproject.org/mirror/sources/ \n \
cvs://.*/.*   http://downloads.yoctoproject.org/mirror/sources/ \n \
git://.*/.*   http://downloads.yoctoproject.org/mirror/sources/ \n \
gitsm://.*/.* http://downloads.yoctoproject.org/mirror/sources/ \n \
hg://.*/.*    http://downloads.yoctoproject.org/mirror/sources/ \n \
osc://.*/.*   http://downloads.yoctoproject.org/mirror/sources/ \n \
p4://.*/.*    http://downloads.yoctoproject.org/mirror/sources/ \n \
svn://.*/.*   http://downloads.yoctoproject.org/mirror/sources/ \n"

MIRRORS =+ "\
ftp://.*/.*      http://downloads.yoctoproject.org/mirror/sources/ \n \
http://.*/.*     http://downloads.yoctoproject.org/mirror/sources/ \n \
https://.*/.*    http://downloads.yoctoproject.org/mirror/sources/ \n"

# Allow reusing DL_DIR from the current build as a mirror for other builds.
BB_GENERATE_MIRROR_TARBALLS = "1"

# The CONNECTIVITY_CHECK_URI's are used to test whether we can succesfully
# fetch from the network (and warn you if not). To disable the test set
# the variable to be empty.
# Git example url: git://git.yoctoproject.org/yocto-firewall-test;protocol=git;rev=master
CONNECTIVITY_CHECK_URIS ?= "https://www.example.com/"

PRSERV_HOST = "localhost:0"
TCLIBCAPPEND = ""

BUILDHISTORY_COMMIT ?= "1"

# Do not use verbose logs for cmake, this reduces build logs significantly, for recipes
# e.g. qtwebkit from 163M down to < 1M
CMAKE_VERBOSE ?= ""

# the following is required because some BSP layers (fsl) don't set this, and then
# other BSP layers fail bitbake parsing (ti).
MACHINE_KERNEL_PR ??= "0"

# accound for some layers which have bbappends for layers we dont include
BB_DANGLINGAPPENDS_WARNONLY = "1"

# Poky goodness
# QA check settings - a little stricter than the OE-Core defaults

WARN_TO_ERROR_QA = "ldflags useless-rpaths rpaths staticdev libdir xorg-driver-abi \
            textrel already-stripped incompatible-license files-invalid \
            installed-vs-shipped compile-host-path install-host-path \
            pn-overrides infodir build-deps src-uri-bad \
            unknown-configure-option symlink-to-sysroot multilib \
            invalid-packageconfig host-user-contaminated uppercase-pn patch-fuzz \
            mime mime-xdg \
            "
WARN_QA_remove = "${WARN_TO_ERROR_QA}"
ERROR_QA_append = " ${WARN_TO_ERROR_QA}"
#ERROR_QA_remove  = "split-strip"
#
# Additional image features
#
# The following is a list of additional classes to use when building images which
# enable extra features. Some available options which can be included in this variable
# are:
#   - 'buildstats' collect build statistics
#   - 'image-mklibs' to reduce shared library files size for an image
#   - 'image-prelink' in order to prelink the filesystem image
#   - 'image-swab' to perform host system intrusion detection
# NOTE: if listing mklibs & prelink both, then make sure mklibs is before prelink
# NOTE: mklibs also needs to be explicitly enabled for a given image, see local.conf.extended
# image-prelink sometimes disabled due to issues with IFUNC symbol relocation
USER_CLASSES ?= "buildstats buildhistory buildstats-summary image-mklibs image-prelink"

IMAGE_CLASSES += "testimage testsdk"

require conf/distro/include/no-static-libs.inc
require conf/distro/include/yocto-uninative.inc
require conf/distro/include/security_flags.inc

INHERIT += "${@bb.utils.contains('BUILD_ARCH', 'ppc64le', '', 'uninative', d)}"

# Add /etc/build to every image
INHERIT += "image-buildinfo"

DISTRO_FEATURES_append = " largefile opengl multiarch wayland pam polkit "

#PREFERRED_PROVIDER_pkgconfig = "pkgconf"
#PREFERRED_PROVIDER_pkgconfig-native = "pkgconf-native"
#PREFERRED_PROVIDER_nativesdk-pkgconfig = "nativesdk-pkgconf"

PREFERRED_PROVIDER_virtual/libgl ??= "mesa"
PREFERRED_PROVIDER_virtual/libgl-native ?= "mesa-native"
PREFERRED_PROVIDER_libgl-native = "mesa-native"
PREFERRED_PROVIDER_virtual/psplash ??= "psplash"
PREFERRED_PROVIDER_psplash-support ??= "psplash"
PREFERRED_PROVIDER_jpeg ??= "libjpeg-turbo"
PREFERRED_PROVIDER_jpeg-native ??= "libjpeg-turbo-native"
PREFERRED_PROVIDER_grub-efi-native ??= "grub-efi-native"
PREFERRED_PROVIDER_u-boot-fw-utils ??= "libubootenv"
PREFERRED_PROVIDER_u-boot ??= "u-boot"

# This helps in using imx specific provider when building for imx platforms, otherwise
# it uses the oe-core versions
IMX_DEFAULT_BOOTLOADER ??= "u-boot"
PREFERRED_PROVIDER_u-boot-tools-native ??= "${IMX_DEFAULT_BOOTLOADER}-tools-native"
PREDERRED_PROVIDED_nativesdk-u-boot-tools ??= "${IMX_DEFAULT_BOOTLOADER}-tools-native"
PREFERRED_PROVIDER_u-boot-mkimage-native ??= "${IMX_DEFAULT_BOOTLOADER}-tools-native"
PREFERRED_PROVIDER_nativesdk-u-boot-mkimage ??= "nativesdk-${IMX_DEFAULT_BOOTLOADER}-tools"

# wpe backend selection, wpebackend-fdo, wpebackend-mesa, wpebackend-rdk
#
PREFERRED_PROVIDER_virtual/wpebackend ??= "wpebackend-fdo"

# Disable qt in wpe
PACKAGECONFIG_remove_pn-wpewebkit = "qtwpe"

# Pin versions, some BSP layers are housing older versions and have higher BBFILE_PRIORITY
# as a result DEFAULT_PREFERENCE = "-1" does not help either so pin it here
PREFERRED_VERSION_swig = "3.0.12"
PREFERRED_VERSION_swig-native = "3.0.12"
PREFERRED_VERSION_swig-nativesdk = "3.0.12"

# the following is required because some BSP layers (fsl) don't set this, and then
# other BSP layers fail bitbake parsing (ti).
MACHINE_KERNEL_PR = "0"

# Enable u-boot for RPI
RPI_USE_U_BOOT = "1"

# Disable rpi raimbow screen
DISABLE_SPLASH = "1"

# swupdate initramfs init system
SWUPDATE_INIT = "tiny"

# we want to have boot + rootfs ( that can grow )
WKS_FILE_beaglebone = "sdimage-bootpart.wks"

INHERIT += "blacklist"
PNBLACKLIST[build-appliance-image] = "tries to include whole downloads directory in /home/builder/poky :/"
PNBLACKLIST[smartrefrigerator] = "Needs porting to QT > 5.6"
PNBLACKLIST[qmlbrowser] = "Needs porting to QT > 5.6"
PNBLACKLIST[minehunt] = "Needs porting to QT > 5.6"
PNBLACKLIST[homeautomation] = "Needs porting to QT > 5.6"
PNBLACKLIST[samegame] = "Needs porting to QT > 5.6"
PNBLACKLIST[applicationlauncher] = "Needs porting to QT > 5.6"
PNBLACKLIST[spacetouch] = "Needs porting to libplanes 1.0"
PNBLACKLIST[qtviewplanes] = "Needs porting to libplanes 1.0"
PNBLACKLIST[egt-thermostat] = "Needs porting to egt 0.8.2+"

# mask out the old webkitgtk recipes from meta-webkit
BBMASK .= "recipes-browser/webkitgtk/webkitgtk"
```

## conf/layer.conf
```bitbake
# We have a conf and classes directory, append to BBPATH
BBPATH .= ":${LAYERDIR}"

# We have a recipes directory, add to BBFILES
BBFILES += "${LAYERDIR}/recipes*/*/*.bb ${LAYERDIR}/recipes*/*/*.bbappend"

BBFILE_COLLECTIONS += "meta-yoe"
BBFILE_PATTERN_meta-yoe := "^${LAYERDIR}/"
BBFILE_PRIORITY_meta-yoe = "99"
LAYERSERIES_COMPAT_meta-yoe = "sumo thud warrior zeus dunfell"
LAYERDEPENDS_meta-yoe = "core elm-binary-layer"

BBFILES_DYNAMIC += " \
    qt4-layer:${LAYERDIR}/dynamic-layers/qt4-layer/*/*/*.bb \
    qt4-layer:${LAYERDIR}/dynamic-layers/qt4-layer/*/*/*.bbappend \
    qt5-layer:${LAYERDIR}/dynamic-layers/qt5-layer/*/*/*.bb \
    qt5-layer:${LAYERDIR}/dynamic-layers/qt5-layer/*/*/*.bbappend \
    meta-96boards:${LAYERDIR}/dynamic-layers/meta-96boards/*/*/*.bb \
    meta-96boards:${LAYERDIR}/dynamic-layers/meta-96boards/*/*/*.bbappend \
    meta-ti:${LAYERDIR}/dynamic-layers/meta-ti/*/*/*.bb \
    meta-ti:${LAYERDIR}/dynamic-layers/meta-ti/*/*/*.bbappend \
    swupdate:${LAYERDIR}/dynamic-layers/swupdate/*/*/*.bb \
    swupdate:${LAYERDIR}/dynamic-layers/swupdate/*/*/*.bbappend \
    webkit:${LAYERDIR}/dynamic-layers/webkit/*/*/*.bb \
    webkit:${LAYERDIR}/dynamic-layers/webkit/*/*/*.bbappend \
"
```

## conf/local.conf
```bitbake
# this following is for settings that are not checked into the build
# template -- see locallocal.conf.sample
include locallocal.conf

# CONF_VERSION is increased each time build/conf/ changes incompatibly
CONF_VERSION = "1"

# Modify the following if you need to change the types of images generated
# most of the time, this is set by the machine conf or in a custom image
# recipe.
IMAGE_FSTYPES_append = " tar.gz wic.xz"

DISTRO = "yoe"

# Dont package kernel into image
RDEPENDS_${KERNEL_PACKAGE_NAME}-base = ""

EXTRA_IMAGE_FEATURES = "debug-tweaks"

# Define a feedserver template to be part of rootfs
PACKAGE_FEED_URIS ??= "http://<FEEDSERVER>"

# Enable serial console on Raspberry PI systems
ENABLE_UART = "1"

#####################################################################
# add project specific configuration below this line
#####################################################################
```

## conf/local.conf.sample
```bitbake
# the contents of local.conf are intended to be user or build machine specific and not
# applicable to the broader team; therefore, it should NOT be checked into Git.

# below is a sample of what might go in local.conf

# if you want to use a directory for downloads other than the default, set
# it here. It is recommended you use this method rather than softlinking
# downloads to another directory, so that the location can be automatically
# mapped into the docker container.
DL_DIR = "/scratch/downloads"

# required for Freescale stuff to build
ACCEPT_FSL_EULA = "1"

# required for Qualcomm stuff to build
ACCEPT_EULA = "1"

# The two lines below enable the Gtk UI frontend for qemu
# default is VNC
PACKAGECONFIG_append_pn-qemu-native = " gtk+"
PACKAGECONFIG_append_pn-nativesdk-qemu = " gtk+"

# components whose licensing have commercial distribution impact
#
# required to build netperf
LICENSE_FLAGS_WHITELIST_append = " non-commercial_netperf "
# chromium
LICENSE_FLAGS_WHITELIST_append = " commercial_ffmpeg commercial_x264 "
# vlc
LICENSE_FLAGS_WHITELIST_append = " commercial_mpeg2dec commercial_vlc "
# mpd
LICENSE_FLAGS_WHITELIST_append = " commercial_mpg123 "
# libmad
LICENSE_FLAGS_WHITELIST_append = " commercial_libmad "
# gstreamer1.0-libav
LICENSE_FLAGS_WHITELIST_append = " commercial_gstreamer1.0-libav "
# gstreamer1.0-omx
LICENSE_FLAGS_WHITELIST_append = " commercial_gstreamer1.0-omx "
# omapfbplay
LICENSE_FLAGS_WHITELIST_append = " commercial_lame "
# libomxil
LICENSE_FLAGS_WHITELIST_append = " commercial_libomxil "
# xfce
LICENSE_FLAGS_WHITELIST_append = " commercial_packagegroup-xfce-multimedia commercial_xfce4-mpc-plugin"
LICENSE_FLAGS_WHITELIST_append = " commercial_xfmpc commercial_mpd "
LICENSE_FLAGS_WHITELIST_append = " commercial_mpv "
# epiphany
LICENSE_FLAGS_WHITELIST_append = " commercial_faad2 "
# gstreamer ugly plugins
LICENSE_FLAGS_WHITELIST_append = " commercial_gstreamer1.0-plugins-ugly "
# sox tools
LICENSE_FLAGS_WHITELIST_append = " commercial_sox "
#
# For full debugging image uncomment following
#
#EXTRA_IMAGE_FEATURES_append = " tools-debug dbg-pkgs"
#
# For native development on device uncomment following
#
#EXTRA_IMAGE_FEATURES_append = " tools-sdk dev-pkgs"
#
```

## sources/meta-yoe/conf/distro/busyboxinit.inc
```bitbake
# enable busybox for init and mdev for device manager
INIT_MANAGER = "mdev-busybox"

# We want to use sysvinit scripts to initialize a complete system
# default is bare system where init system needs to be told what to run
DISTRO_FEATURES:append = " sysvinit "
DISTRO_FEATURES_BACKFILL_CONSIDERED:remove = "sysvinit"
```
