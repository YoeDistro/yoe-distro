## sources/meta-yoe/conf/distro/commercial-eula.inc
```bitbake
# components whose licensing have commercial distribution impact
#
# required to build netperf
LICENSE_FLAGS_ACCEPTED:append = " non-commercial_netperf "
# chromium
LICENSE_FLAGS_ACCEPTED:append = " commercial_ffmpeg commercial_x264 commercial_x265"
# vlc
LICENSE_FLAGS_ACCEPTED:append = " commercial_mpeg2dec commercial_vlc "
# mpd
LICENSE_FLAGS_ACCEPTED:append = " commercial_mpg123 "
# libmad
LICENSE_FLAGS_ACCEPTED:append = " commercial_libmad "
# gstreamer1.0-libav
LICENSE_FLAGS_ACCEPTED:append = " commercial_gstreamer1.0-libav "
# gstreamer1.0-omx
LICENSE_FLAGS_ACCEPTED:append = " commercial_gstreamer1.0-omx "
# omapfbplay
LICENSE_FLAGS_ACCEPTED:append = " commercial_lame "
# libomxil
LICENSE_FLAGS_ACCEPTED:append = " commercial_libomxil "
# xfce
LICENSE_FLAGS_ACCEPTED:append = " commercial_packagegroup-xfce-multimedia commercial_xfce4-mpc-plugin"
LICENSE_FLAGS_ACCEPTED:append = " commercial_xfmpc commercial_mpd "
LICENSE_FLAGS_ACCEPTED:append = " commercial_mpv "
# epiphany
LICENSE_FLAGS_ACCEPTED:append = " commercial_faad2 "
# gstreamer ugly plugins
LICENSE_FLAGS_ACCEPTED:append = " commercial_gstreamer1.0-plugins-ugly "
# sox tools
LICENSE_FLAGS_ACCEPTED:append = " commercial_sox "
# libde265
LICENSE_FLAGS_ACCEPTED:append = " commercial_libde265 "
#
```

## sources/meta-yoe/conf/distro/eglfs.inc
```bitbake
DISTRO_FEATURES:remove = " x11 wayland"
DISTRO_FEATURES_NATIVESDK:append = " wayland"
DISTRO_FEATURES_NATIVE:append = " wayland"
# Use rdk backend for eglfs
PREFERRED_PROVIDER_virtual/wpebackend = "wpebackend-rdk"
```
